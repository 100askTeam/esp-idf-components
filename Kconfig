## tft_lcd_100ask_drivers/Kconfig
```kconfig
menu "100ASK SPI TFT LCD setting"
    menu "SPI TFT LCD Pin Assignments"
        depends on USE_100ASK_SPI_TFT_LCD

        choice
            bool "Select a display controller model"
            default USE_100ASK_SPI_TFT_LCD_320X480
            help
                Default display controller model

            config USE_100ASK_SPI_TFT_LCD_320X480
                bool "320X480"
                help
                    https://forums.100ask.net
        endchoice

        config SPI_TFT_LCD_100ASK_DISP_WIDTH
            int "Screen width"
            default 320

            help
                Configure the display screen width here.

        config SPI_TFT_LCD_100ASK_DISP_HEIGHT
            int "Screen height"
            default 480

            help
                Configure the display screen height here.

        config SPI_TFT_LCD_100ASK_DISP_SPI_FREQUENCY
            int "Configure the display SPI frequency"
            default 40000000

            help
                Configure the display SPI frequency here.

        config SPI_TFT_LCD_100ASK_DISP_SPI_MODE
            int "Configure the display SPI mode"
            default 0

            help
                Configure the display SPI mode here.

        config SPI_TFT_LCD_100ASK_DISP_PIN_MOSI
            int "GPIO for MOSI (Master Out Slave In (SDI PIN))"
            default 11

            help
                Configure the display MOSI (SDI PIN) pin here.
                
        config SPI_TFT_LCD_100ASK_DISPLAY_USE_PIN_MISO
            bool "GPIO for MISO (Master In Slave Out)"
            default n

            help
                Enable the MISO signal to control the display. You can disable
                it when the display does not need MISO signal to be controlled.

        config SPI_TFT_LCD_100ASK_DISP_PIN_MISO
            int "GPIO for MISO (Master In Slave Out)"
            depends on SPI_TFT_LCD_100ASK_DISPLAY_USE_PIN_MISO
            default -1
            default 0

            help
                Configure the display MISO pin here.s

        config SPI_TFT_LCD_100ASK_DISP_PIN_CLK
            int "GPIO for CLK (SCK / Serial Clock)"
            default 12

            help
                Configure the display CLK pin here.

        config SPI_TFT_LCD_100ASK_DISP_PIN_CS
            int "GPIO for CS (Slave Select)"
            default 10

            help
                Configure the display CS pin here.

        config SPI_TFT_LCD_100ASK_DISP_PIN_DC
            int "GPIO for DC (Data / Command)"
            default 5

            help
                Configure the display DC pin here.
            
        config SPI_TFT_LCD_100ASK_DISP_PIN_RST
            int "GPIO for Reset" 
            default 6

            help
                Configure the display Reset pin here.

        config SPI_TFT_LCD_100ASK_DISP_PIN_BACKLIGHT
            int "GPIO for backlight"
            default 7

            help
                Configure the display Busy pin here.

        config SPI_TFT_LCD_100ASK_BACKLIGHT_PWM
            bool
            prompt "PWM control"

            help
                Display backlight is controlled by pulse-width modulation, allowing brightness settings.

        choice
            default SPI_TFT_LCD_100ASK_BACKLIGHT_SWITCH
            prompt "Backlight Control"
    
            config SPI_TFT_LCD_100ASK_DISP_BACKLIGHT_OFF
                bool
                prompt "Not Used"

                help
                    Display backlight is not controlled by this driver, must be hardwired in hardware.
    
            config SPI_TFT_LCD_100ASK_BACKLIGHT_SWITCH
                bool
                prompt "Switch control"

                help
                    Display backlight can be switched on or off.
    
            config SPI_TFT_LCD_100ASK_BACKLIGHT_PWM
                bool
                prompt "PWM control"
                
                help
                    Display backlight is controlled by pulse-width modulation, allowing brightness settings.
    
        endchoice
        
        
    endmenu
    
    config USE_100ASK_SPI_TFT_LCD
        bool "Display SPI TFT LCD Pin Assignments"
        default "n"

        help 
            Display SPI TFT LCD Pin Assignments

endmenu
```
