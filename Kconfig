## Kconfig
```kconfig
menu "100ask components"
    rsource "epd_100ask_drivers/Kconfig"
    rsource "epd_100ask_paint/Kconfig"
    rsource "display_100ask_driver/Kconfig"
    rsource "fc_joypad_100ask_drivers/Kconfig"
    rsource "fs_100ask_drivers/Kconfig"
    rsource "lv_lib_100ask/Kconfig"
    rsource "lvgl/Kconfig"
endmenu
```

## display_100ask_driver/Kconfig
```kconfig
menu "100ASK display screen setting"
    menu "Display screen Pin Assignments"
        depends on USE_100ASK_DISPLAY_SCREEN

        choice
            bool "Select the screen interface"
            default USE_100ASK_SPI_DISPLAY_SCREEN
            
            config USE_100ASK_SPI_DISPLAY_SCREEN
                bool "SPI Interfaced DISPLAY_SCREEN"
                help
                    https://forums.100ask.net
            
            config USE_100ASK_I2C_DISPLAY_SCREEN
                bool "I2C Interfaced DISPLAY_SCREEN"
                help
                    not yet done
        endchoice

        choice
            bool "Select the drive type for DISPLAY_SCREEN"
            default USE_100ASK_DISPLAY_SCREEN_SPI_DRIVE if USE_100ASK_SPI_DISPLAY_SCREEN
            default USE_100ASK_DISPLAY_SCREEN_I2C_DRIVE if USE_100ASK_I2C_DISPLAY_SCREEN
            
            config USE_100ASK_DISPLAY_SCREEN_SPI_DRIVE
                bool "spi display screen drive"
                help
                    https://forums.100ask.net
            
            config USE_100ASK_DISPLAY_SCREEN_I2C_DRIVE
                bool "i2c display screen drive"
                help
                    not yet done
            
            config USE_100ASK_DISPLAY_SCREEN_ESP_LCD_PANEL
                bool "esp lcd panel drive"
                help
                    https://forums.100ask.net
        endchoice
        
        choice
            bool "Select the model of the display"
            default USE_100ASK_DISPLAY_SCREEN_320X480
            help
                Default display controller model
            
            config USE_100ASK_DISPLAY_SCREEN_170X320
                bool "170X320"
                help
                    https://forums.100ask.net
            
            config USE_100ASK_DISPLAY_SCREEN_240X240
                bool "240X240"
                help
                    https://forums.100ask.net
        
            config USE_100ASK_DISPLAY_SCREEN_320X480
                bool "320X480"
                help
                    https://forums.100ask.net
        endchoice

        config DISPLAY_SCREEN_100ASK_ROTATION
            int "Set display rotation angle"
            default 0

            help
                The rotation angles you can choose are: 90, 180, 270.

        config DISPLAY_SCREEN_100ASK_WIDTH
            int "Screen width"
            default 170 if USE_100ASK_DISPLAY_SCREEN_170X320
            default 240 if USE_100ASK_DISPLAY_SCREEN_240X240
            default 320 if USE_100ASK_DISPLAY_SCREEN_320X480

            help
                Configure the display screen width here.

        config DISPLAY_SCREEN_100ASK_HEIGHT
            int "Screen height"
            default 320 if USE_100ASK_DISPLAY_SCREEN_170X320
            default 240 if USE_100ASK_DISPLAY_SCREEN_240X240
            default 480 if USE_100ASK_DISPLAY_SCREEN_320X480

            help
                Configure the display screen height here.
        
        config DISPLAY_SCREEN_100ASK_SPI_FREQUENCY
            int "Configure the display screen SPI frequency"
            depends on USE_100ASK_SPI_DISPLAY_SCREEN
            default 40000000

            help
                Configure the display SPI frequency here.

        config DISPLAY_SCREEN_100ASK_SPI_MODE
            int "Configure the display screen SPI mode"
            depends on USE_100ASK_SPI_DISPLAY_SCREEN
            default 0

            help
                Configure the display SPI mode here.
        
        config DISPLAY_SCREEN_100ASK_SPI_HOST
            int "Configure the display screen SPI HOST"
            depends on USE_100ASK_SPI_DISPLAY_SCREEN
            default 1

            help
                0: SPI1_HOST, 1: SPI2_HOST, 2: SPI3_HOST=2

        config DISPLAY_SCREEN_100ASK_SPI_PIN_MOSI
            int "GPIO for MOSI (Master Out Slave In (SDI PIN))"
            depends on USE_100ASK_SPI_DISPLAY_SCREEN
            default 11

            help
                Configure the display MOSI (SDI PIN) pin here.

        config DISPLAY_SCREEN_100ASK_SPI_PIN_MISO
            int "GPIO for MISO (Master In Slave Out)"
            default 13

            help
                Configure the display MISO pin here.

        config DISPLAY_SCREEN_100ASK_SPI_PIN_CLK
            int "GPIO for CLK (SCK / Serial Clock)"
            depends on USE_100ASK_SPI_DISPLAY_SCREEN
            default 12

            help
                Configure the display CLK pin here.

        config DISPLAY_SCREEN_100ASK_SPI_PIN_CS
            int "GPIO for CS (Slave Select)"
            depends on USE_100ASK_SPI_DISPLAY_SCREEN
            default 10

            help
                Configure the display CS pin here.

        config DISPLAY_SCREEN_100ASK_SPI_PIN_DC
            int "GPIO for DC (Data / Command)"
            depends on USE_100ASK_SPI_DISPLAY_SCREEN
            default 5

            help
                Configure the display DC pin here.
            
        config DISPLAY_SCREEN_100ASK_SPI_PIN_RST
            int "GPIO for Reset" 
            depends on USE_100ASK_SPI_DISPLAY_SCREEN
            default 6

            help
                Configure the display Reset pin here.

        config USE_100ASK_DISPLAY_SCREEN_BACKLIGHT
            bool "DISPLAY_SCREEN BACKLIGHT"
            default "n"

            help
                https://forums.100ask.net
        
        config DISPLAY_SCREEN_100ASK_PIN_BACKLIGHT
            int "GPIO for backlight"
            depends on USE_100ASK_DISPLAY_SCREEN_BACKLIGHT
            default 7

            help
                Configure the display Busy pin here.

        choice
            depends on USE_100ASK_DISPLAY_SCREEN_BACKLIGHT
            default DISPLAY_SCREEN_100ASK_BACKLIGHT_PWM
            prompt "Backlight Control"
    
            config DISPLAY_SCREEN_100ASK_BACKLIGHT_OFF
                bool
                prompt "Not Used"

                help
                    Display backlight is not controlled by this driver, must be hardwired in hardware.
    
            config DISPLAY_SCREEN_100ASK_BACKLIGHT_SWITCH
                bool
                prompt "Switch control"

                help
                    Display backlight can be switched on or off.
    
            config DISPLAY_SCREEN_100ASK_BACKLIGHT_PWM
                bool
                prompt "PWM control"
                
                help
                    Display backlight is controlled by pulse-width modulation, allowing brightness settings.
    
        endchoice
        
    endmenu
    
    config USE_100ASK_DISPLAY_SCREEN
        bool "DISPLAY_SCREEN Pin Assignments"
        default "n"

        help 
            DISPLAY_SCREEN Pin Assignments

endmenu
```

## epd_100ask_drivers/Kconfig
```kconfig
menu "100ASK EPD setting"
    menu "EPD Pin Assignments"
        depends on USE_100ASK_EPD

        config EPD_100ASK_DISP_SPI_FREQUENCY
            int "Configure the display SPI frequency"
            default 25000000

            help
                Configure the display SPI frequency here.

        config EPD_100ASK_DISP_SPI_MODE
            int "Configure the display SPI mode"
            default 0

            help
                Configure the display SPI mode here.

        config EPD_100ASK_DISP_PIN_MOSI
            int "GPIO for MOSI (Master Out Slave In (SDI PIN))"
            default 11

            help
                Configure the display MOSI (SDI PIN) pin here.
                
        config EPD_100ASK_DISPLAY_USE_PIN_MISO
            bool "GPIO for MISO (Master In Slave Out)"
            default n

            help
                Enable the MISO signal to control the display. You can disable
                it when the display does not need MISO signal to be controlled.

        config EPD_100ASK_DISP_PIN_MISO
            int "GPIO for MISO (Master In Slave Out)"
            depends on EPD_100ASK_DISPLAY_USE_PIN_MISO
            default -1
            default 0

            help
                Configure the display MISO pin here.s

        config EPD_100ASK_DISP_PIN_CLK
            int "GPIO for CLK (SCK / Serial Clock)"
            default 12

            help
                Configure the display CLK pin here.

        config EPD_100ASK_DISP_PIN_CS
            int "GPIO for CS (Slave Select)"
            default 10

            help
                Configure the display CS pin here.

        config EPD_100ASK_DISP_PIN_DC
            int "GPIO for DC (Data / Command)"
            default 5

            help
                Configure the display DC pin here.
            
        config EPD_100ASK_DISP_PIN_RST
            int "GPIO for Reset" 
            default 6

            help
                Configure the display Reset pin here.

        config EPD_100ASK_DISP_PIN_BUSY
            int "GPIO for Busy"
            default 7

            help
                Configure the display Busy pin here.
        
        config EPD_100ASK_DISP_WIDTH
            int "Screen width"
            default 240

            help
                Configure the display screen width here.

        config EPD_100ASK_DISP_HEIGHT
            int "Screen height"
            default 360

            help
                Configure the display screen height here.
    endmenu
    
    config USE_100ASK_EPD
        bool "Display EPD Pin Assignments"
        default "n"

        help 
            Display EPD Pin Assignments

endmenu
```

## epd_100ask_paint/Kconfig
```kconfig
menu "100ASK EPD  paint setting"
    menu "EPD paint Assignments"
        depends on USE_100ASK_EPD_PAINT

        config EPD_100ASK_PAINT_WIDTH
            int "Configure the paint width"
            default 240

            help
                Configure the paint width here.

        config EPD_100ASK_PAINT_HEIGHT
            int "Configure the paint heigt"
            default 360

            help
                Configure the paint heigt here.
                
    endmenu
    
    config USE_100ASK_EPD_PAINT
        bool "Display EPD Pin Assignments"
        default "n"

        help 
            Display EPD Pin Assignments
endmenu
```

## fc_joypad_100ask_drivers/Kconfig
```kconfig
menu "100ASK FC joypad setting"
    menu "FC joypad Assignments"
        depends on USE_100ASK_FC_JOYPAD

        config 100ASK_FC_JOYPAD_CLOCK_PIN
            int "Configure the FC joypad clock pin(ID)"
            default 40

            help
                Configure the FC joypad clock pin(ID) here.

        config 100ASK_FC_JOYPAD_LATCH_PIN
            int "Configure the FC joypad latch pin(D+)"
            default 41

            help
                Configure the fc joypad latch pin(D+) here.

        config 100ASK_FC_JOYPAD_DATA_PIN
            int "Configure the FC joypad data pin(D-)"
            default 42

            help
                Configure the FC joypad data pin(D-) here.
                
    endmenu
    
    config USE_100ASK_FC_JOYPAD
        bool "Display FC joypad Pin Assignments"
        default "n"
        
        help 
            Display FC joypad Pin Assignments
endmenu
```

## fs_100ask_drivers/Kconfig
```kconfig
menu "100ASK File system drivers setting"
    menu "File system Pin Assignments"
        depends on USE_100ASK_FS_DRIVERS

        choice
            bool "Select the storage peripheral type"
            default USE_100ASK_INTERNAL_FLASH
            help
                Select the storage peripheral type

            config USE_100ASK_EXTERNAL_SDCARD_SPI
                bool "Use External SDCard(MicroSD Card Adapter)"
            config USE_100ASK_INTERNAL_FLASH
                bool "Use Internal Flash"
        endchoice

        config FS_DRIVERS_MOUNT_POINT
            string "Set mount point"
            default "/disk"

            help
                Set file system mount point.

        choice
            bool "File system interfaces for common APIs(LVGL)"
            default LV_USE_100ASK_FS_FATFS
            help
                SFile system interfaces for common APIs(LVGL)

            config LV_USE_100ASK_FS_FATFS
                bool "API for FATFS (needs to be added separately). Uses f_open, f_read, etc"
        endchoice

        menu "SPI SD card setting"
            depends on USE_100ASK_EXTERNAL_SDCARD_SPI

            config SPI_SD_CARD_100ASK_PIN_MOSI
                int "GPIO for MOSI (Master Out Slave In (SDI PIN))"
                default 17
    
                help
                    Configure the display MOSI (SDI PIN) pin here.
    
            config SPI_SD_CARD_100ASK_PIN_MISO
                int "GPIO for MISO (Master In Slave Out)"
                default 18
    
                help
                    Configure the display MISO pin here
    
            config SPI_SD_CARD_100ASK_PIN_CLK
                int "GPIO for CLK (SCK / Serial Clock)"
                default 16
    
                help
                    Configure the display CLK pin here.
    
            config SPI_SD_CARD_100ASK_PIN_CS
                int "GPIO for CS (Slave Select)"
                default 15
    
                help
                    Configure the display CS pin here.
    
            config SPI_SD_CARD_100ASK_MAX_TRANSFER_SIZE
                int "SPI bus max transfer size"
                default 4000
                
        endmenu
    endmenu
    
    config USE_100ASK_FS_DRIVERS
        bool "Display 100ask file system drivers Pin Assignments"
        default "n"

        help 
            Display 100ask file system drivers Pin Assignments

endmenu
```
